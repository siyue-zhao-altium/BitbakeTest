## Kconfig
```kconfig
mainmenu "Image Builder"

config KAS_BUILD_SYSTEM
	string
	default "openembedded"

menu "Select the Image to build"
choice
	prompt "Select the Image builder you want to use"
	default DUMMY_FAST

	config HELLO_WORLD
	bool "Hello world takes 5 mins"

	config KAS_INCLUDE_HELLO_WORLD
	string
	depends on HELLO_WORLD
	default "helloWorld5min.yaml"

	config DUMMY_FAST
	bool "Dummy image takes 10s to build"

	config KAS_INCLUDE_DUMMY_FAST
	string
	depends on DUMMY_FAST
	default "blink10s.yaml"
endchoice
endmenu


config HELLO_MESSAGE
string "SET HELLO_MESSAGE"
default "Enter your message here"
help
	Set the HELLO_MESSAGE: Anything.
```

## conf/layer.conf
```bitbake
# meta-test layer configuration
BBPATH .= ":${LAYERDIR}"
BBFILES += "${LAYERDIR}/recipes-*/*/*.bb"

BBFILE_COLLECTIONS += "test"
BBFILE_PATTERN_test = "^${LAYERDIR}/"
BBFILE_PRIORITY_test = "1"
```

## meta-test/conf/machine/dummy-machine.conf
```bitbake
#@TYPE: Machine
#@NAME: Dummy Machine
#@DESCRIPTION: Machine configuration for a dummy target

MACHINE_FEATURES = ""
IMAGE_FSTYPES = "tar.gz"

TUNE_ARCH = "allarch"
TARGET_OS = "linux"

PREFERRED_PROVIDER_virtual/kernel = "linux-dummy"
```
